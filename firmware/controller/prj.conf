## prj.conf
```kconfig
CONFIG_ESB=y
CONFIG_LOG=n
CONFIG_SERIAL=n
CONFIG_CONSOLE=n
CONFIG_UART_CONSOLE=n
CONFIG_GPIO=y
CONFIG_ADC_ASYNC=y
# Enable ADC for analog inputs
CONFIG_ADC=y

# Enable I2C for trackpad and display
CONFIG_I2C=y
# I2C timeout protection to prevent freezes from unresponsive devices (100ms timeout)
CONFIG_I2C_NRFX_TRANSFER_TIMEOUT=100

# Disable NFC to free up P0.09 and P0.10 for DRV2605 haptic control
CONFIG_NFCT_PINS_AS_GPIOS=y

# Display support for SSD1306
CONFIG_DISPLAY=y
CONFIG_SSD1306=y

# LVGL Graphics Library (temporarily disabled - causing boot issues)
# CONFIG_LVGL=y
# CONFIG_LV_Z_VDB_SIZE=16
# CONFIG_LV_COLOR_DEPTH_1=y
# CONFIG_LV_Z_MEM_POOL_SIZE=8192

# Enable sensor subsystem for IMU
CONFIG_SENSOR=y
CONFIG_LSM6DSL=y

# Enable ESB
CONFIG_ESB_MAX_PAYLOAD_LENGTH=32

# Settings subsystem for NVS storage
CONFIG_SETTINGS=y
CONFIG_SETTINGS_NVS=y
CONFIG_NVS=y
CONFIG_FLASH=y
CONFIG_FLASH_MAP=y
CONFIG_MPU_ALLOW_FLASH_WRITE=y

# Power Management for nRF52840
CONFIG_PM=y
CONFIG_POWEROFF=y
CONFIG_PM_DEVICE=y
CONFIG_TICKLESS_KERNEL=y
CONFIG_GPIO_ENABLE_DISABLE_INTERRUPT=y

# Enable SAADC driver
CONFIG_NRFX_SAADC=y

# Logging levels
CONFIG_LOG_DEFAULT_LEVEL=3
CONFIG_ESB_LOG_LEVEL_INF=y
CONFIG_LOG_PRINTK=y
CONFIG_LOG_PROCESS_THREAD_STACK_SIZE=1024

# System
CONFIG_MAIN_STACK_SIZE=2048
CONFIG_SYSTEM_WORKQUEUE_STACK_SIZE=2048
```

## src/IQS7211E_init.h
```c
/*
* This file contains all the necessary settings for the IQS7211E and this file can
* be changed from the GUI or edited here
* File:   IQS7211E_init.h
* Author: Azoteq
*/ 

#ifndef IQS7211E_INIT_H
#define IQS7211E_INIT_H

/* Change the ALP ATI Compensation */
/* Memory Map Position 0x1F - 0x20 */
#define ALP_COMPENSATION_A_0                     0x51
#define ALP_COMPENSATION_A_1                     0x01
#define ALP_COMPENSATION_B_0                     0x5A
#define ALP_COMPENSATION_B_1                     0x01

/* Change the ATI Settings */
/* Memory Map Position 0x21 - 0x27 */
#define TP_ATI_MULTIPLIERS_DIVIDERS_0            0xE1
#define TP_ATI_MULTIPLIERS_DIVIDERS_1            0x21
#define TP_COMPENSATION_DIV                      0x06
#define TP_REF_DRIFT_LIMIT                       0x32
#define TP_ATI_TARGET_0                          0x2C
#define TP_ATI_TARGET_1                          0x01
#define TP_MIN_COUNT_REATI_0                     0x32
#define TP_MIN_COUNT_REATI_1                     0x00
#define ALP_ATI_MULTIPLIERS_DIVIDERS_0           0x23
#define ALP_ATI_MULTIPLIERS_DIVIDERS_1           0x02
#define ALP_COMPENSATION_DIV                     0x02
#define ALP_LTA_DRIFT_LIMIT                      0x14
#define ALP_ATI_TARGET_0                         0xC8
#define ALP_ATI_TARGET_1                         0x00

/* Change the Report Rates and Timing */
/* Memory Map Position 0x28 - 0x32 */
#define ACTIVE_MODE_REPORT_RATE_0                0x1E
#define ACTIVE_MODE_REPORT_RATE_1                0x00
#define IDLE_TOUCH_MODE_REPORT_RATE_0            0x40
#define IDLE_TOUCH_MODE_REPORT_RATE_1            0x00
#define IDLE_MODE_REPORT_RATE_0                  0x20
#define IDLE_MODE_REPORT_RATE_1                  0x00
#define LP1_MODE_REPORT_RATE_0                   0x80
#define LP1_MODE_REPORT_RATE_1                   0x00
#define LP2_MODE_REPORT_RATE_0                   0x00
#define LP2_MODE_REPORT_RATE_1                   0x01
#define ACTIVE_MODE_TIMEOUT_0                    0x1E
#define ACTIVE_MODE_TIMEOUT_1                    0x00
#define IDLE_TOUCH_MODE_TIMEOUT_0                0x3C
#define IDLE_TOUCH_MODE_TIMEOUT_1                0x00
#define IDLE_MODE_TIMEOUT_0                      0x1E
#define IDLE_MODE_TIMEOUT_1                      0x00
#define LP1_MODE_TIMEOUT_0                       0x1E
#define LP1_MODE_TIMEOUT_1                       0x00
#define REATI_RETRY_TIME                         0x05
#define REF_UPDATE_TIME                          0x08
#define I2C_TIMEOUT_0                            0x64
#define I2C_TIMEOUT_1                            0x00

/* Change the System Settings */
/* Memory Map Position 0x33 - 0x35 */
#define SYSTEM_CONTROL_0                         0x00
#define SYSTEM_CONTROL_1                         0x00
#define CONFIG_SETTINGS0                         0x8C
#define CONFIG_SETTINGS1                         0x45
#define OTHER_SETTINGS_0                         0x10
#define OTHER_SETTINGS_1                         0x00

/* Change the ALP Settings */
/* Memory Map Position 0x36 - 0x37 */
#define ALP_SETUP_0                              0x77
#define ALP_SETUP_1                              0x03
#define ALP_TX_ENABLE_0                          0x08
#define ALP_TX_ENABLE_1                          0x05

/* Change the Thresholds and Debounce Settings */
/* Memory Map Position 0x38 - 0x3A */
#define TRACKPAD_TOUCH_SET_THRESHOLD             0x14
#define TRACKPAD_TOUCH_CLEAR_THRESHOLD           0x0E
#define ALP_THRESHOLD_0                          0x08
#define ALP_THRESHOLD_1                          0x00
#define ALP_SET_DEBOUNCE                         0x04
#define ALP_CLEAR_DEBOUNCE                       0x04

/* Change the Button and ALP count and LTA betas */
/* Memory Map Position 0x3B - 0x3C */
#define ALP_COUNT_BETA_LP1                       0xDC
#define ALP_LTA_BETA_LP1                         0x08
#define ALP_COUNT_BETA_LP2                       0xF0
#define ALP_LTA_BETA_LP2                         0x10

/* Change the Hardware Settings */
/* Memory Map Position 0x3D - 0x40 */
#define TP_CONVERSION_FREQUENCY_UP_PASS_LENGTH   0x02
#define TP_CONVERSION_FREQUENCY_FRACTION_VALUE   0x1A
#define ALP_CONVERSION_FREQUENCY_UP_PASS_LENGTH  0x02
#define ALP_CONVERSION_FREQUENCY_FRACTION_VALUE  0x1A
#define TRACKPAD_HARDWARE_SETTINGS_0             0x03
#define TRACKPAD_HARDWARE_SETTINGS_1             0x9C
#define ALP_HARDWARE_SETTINGS_0                  0x23
#define ALP_HARDWARE_SETTINGS_1                  0x9C

/* Change the Trackpad Settings */
/* Memory Map Position 0x41 - 0x49 */
#define TRACKPAD_SETTINGS_0_0                    0x28
#define TRACKPAD_SETTINGS_0_1                    0x06
#define TRACKPAD_SETTINGS_1_0                    0x06
#define TRACKPAD_SETTINGS_1_1                    0x02
#define X_RESOLUTION_0                           0xFF
#define X_RESOLUTION_1                           0x03
#define Y_RESOLUTION_0                           0xFF
#define Y_RESOLUTION_1                           0x03
#define XY_DYNAMIC_FILTER_BOTTOM_SPEED_0         0x02
#define XY_DYNAMIC_FILTER_BOTTOM_SPEED_1         0x00
#define XY_DYNAMIC_FILTER_TOP_SPEED_0            0x10
#define XY_DYNAMIC_FILTER_TOP_SPEED_1            0x00
#define XY_DYNAMIC_FILTER_BOTTOM_BETA            0x01
#define XY_DYNAMIC_FILTER_STATIC_FILTER_BETA     0x00
#define STATIONARY_TOUCH_MOV_THRESHOLD           0x14
#define FINGER_SPLIT_FACTOR                      0x03
#define X_TRIM_VALUE                             0x14
#define Y_TRIM_VALUE                             0x14

/* Change the Settings Version Numbers */
/* Memory Map Position 0x4A - 0x4A */
#define MINOR_VERSION                            0x00
#define MAJOR_VERSION                            0x00

/* Change the Gesture Settings */
/* Memory Map Position 0x4B - 0x55 */
#define GESTURE_ENABLE_0                         0x00
#define GESTURE_ENABLE_1                         0x00
#define TAP_TOUCH_TIME_0                         0xC8
#define TAP_TOUCH_TIME_1                         0x00
#define TAP_WAIT_TIME_0                          0x96
#define TAP_WAIT_TIME_1                          0x00
#define TAP_DISTANCE_0                           0x32
#define TAP_DISTANCE_1                           0x00
#define HOLD_TIME_0                              0x2C
#define HOLD_TIME_1                              0x01
#define SWIPE_TIME_0                             0x96
#define SWIPE_TIME_1                             0x00
#define SWIPE_X_DISTANCE_0                       0xC8
#define SWIPE_X_DISTANCE_1                       0x00
#define SWIPE_Y_DISTANCE_0                       0xC8
#define SWIPE_Y_DISTANCE_1                       0x00
#define SWIPE_X_CONS_DIST_0                      0x64
#define SWIPE_X_CONS_DIST_1                      0x00
#define SWIPE_Y_CONS_DIST_0                      0x64
#define SWIPE_Y_CONS_DIST_1                      0x00
#define SWIPE_ANGLE                              0x17
#define PALM_THRESHOLD                           0x1E

/* Change the RxTx Mapping */
/* Memory Map Position 0x56 - 0x5C */
#define RX_TX_MAP_0                              0x01
#define RX_TX_MAP_1                              0x02
#define RX_TX_MAP_2                              0x00
#define RX_TX_MAP_3                              0x05
#define RX_TX_MAP_4                              0x04
#define RX_TX_MAP_5                              0x06
#define RX_TX_MAP_6                              0x03
#define RX_TX_MAP_7                              0x07
#define RX_TX_MAP_8                              0x08
#define RX_TX_MAP_9                              0x09
#define RX_TX_MAP_10                             0x0A
#define RX_TX_MAP_11                             0x0B
#define RX_TX_MAP_12                             0x0C
#define RX_TX_MAP_FILLER                         0x00

/* Change the Allocation of channels into cycles 0-9 */
/* Memory Map Position 0x5D - 0x6B */
#define PLACEHOLDER_0                            0x05
#define CH_1_CYCLE_0                             0x00
#define CH_2_CYCLE_0                             0x03
#define PLACEHOLDER_1                            0x05
#define CH_1_CYCLE_1                             0x01
#define CH_2_CYCLE_1                             0x04
#define PLACEHOLDER_2                            0x05
#define CH_1_CYCLE_2                             0x02
#define CH_2_CYCLE_2                             0x05
#define PLACEHOLDER_3                            0x05
#define CH_1_CYCLE_3                             0x06
#define CH_2_CYCLE_3                             0x09
#define PLACEHOLDER_4                            0x05
#define CH_1_CYCLE_4                             0x07
#define CH_2_CYCLE_4                             0x0A
#define PLACEHOLDER_5                            0x05
#define CH_1_CYCLE_5                             0x08
#define CH_2_CYCLE_5                             0x0B
#define PLACEHOLDER_6                            0x05
#define CH_1_CYCLE_6                             0x0C
#define CH_2_CYCLE_6                             0x0F
#define PLACEHOLDER_7                            0x05
#define CH_1_CYCLE_7                             0x0D
#define CH_2_CYCLE_7                             0x10
#define PLACEHOLDER_8                            0x05
#define CH_1_CYCLE_8                             0x0E
#define CH_2_CYCLE_8                             0x11
#define PLACEHOLDER_9                            0x05
#define CH_1_CYCLE_9                             0x12
#define CH_2_CYCLE_9                             0x15

/* Change the Allocation of channels into cycles 10-19 */
/* Memory Map Position 0x6C - 0x7A */
#define PLACEHOLDER_10                           0x05
#define CH_1_CYCLE_10                            0x13
#define CH_2_CYCLE_10                            0x16
#define PLACEHOLDER_11                           0x05
#define CH_1_CYCLE_11                            0x14
#define CH_2_CYCLE_11                            0x17
#define PLACEHOLDER_12                           0x05
#define CH_1_CYCLE_12                            0x18
#define CH_2_CYCLE_12                            0x1B
#define PLACEHOLDER_13                           0x05
#define CH_1_CYCLE_13                            0x19
#define CH_2_CYCLE_13                            0x1C
#define PLACEHOLDER_14                           0x05
#define CH_1_CYCLE_14                            0x1A
#define CH_2_CYCLE_14                            0x1D
#define PLACEHOLDER_15                           0x05
#define CH_1_CYCLE_15                            0x20
#define CH_2_CYCLE_15                            0x21
#define PLACEHOLDER_16                           0x05
#define CH_1_CYCLE_16                            0x1F
#define CH_2_CYCLE_16                            0x22
#define PLACEHOLDER_17                           0x05
#define CH_1_CYCLE_17                            0x1E
#define CH_2_CYCLE_17                            0x23
#define PLACEHOLDER_18                           0x05
#define CH_1_CYCLE_18                            0xFF
#define CH_2_CYCLE_18                            0xFF
#define PLACEHOLDER_19                           0x05
#define CH_1_CYCLE_19                            0xFF
#define CH_2_CYCLE_19                            0xFF

/* Change the Allocation of channels into cycles 20 */
/* Memory Map Position 0x7B - 0x7C */
#define PLACEHOLDER_20                           0x05
#define CH_1_CYCLE_20                            0xFF
#define CH_2_CYCLE_20                            0xFF

#endif	/* IQS7211E_INIT_H */
```

## src/analog_driver.h
```c
/**
 ******************************************************************************
 * @file    analog_driver.h
 * @brief   ADC Analog Input Driver Library for Controller
 * @author  Controller Team
 * @version V1.0
 * @date    2025
 ******************************************************************************
 * @attention
 * 
 * This library provides a clean interface for managing ADC analog inputs
 * including analog sticks, triggers, and other analog sensors with
 * calibration, filtering, and deadzone support.
 * 
 ******************************************************************************
 */

#ifndef ANALOG_DRIVER_H
#define ANALOG_DRIVER_H

#include <zephyr/kernel.h>
#include <zephyr/drivers/adc.h>
#include <stdint.h>
#include <stdbool.h>

// Analog status enumeration
typedef enum {
    ANALOG_STATUS_OK = 0,
    ANALOG_STATUS_ERROR = -1,
    ANALOG_STATUS_NOT_INITIALIZED = -2,
    ANALOG_STATUS_INVALID_CHANNEL = -3,
    ANALOG_STATUS_CALIBRATION_FAILED = -4,
    ANALOG_STATUS_ADC_ERROR = -5
} analog_status_t;

// Analog channel enumeration
typedef enum {
    ANALOG_CHANNEL_STICK_X = 0,
    ANALOG_CHANNEL_STICK_Y,
    ANALOG_CHANNEL_TRIGGER,
    ANALOG_CHANNEL_BATTERY,     // Battery voltage monitoring
    ANALOG_CHANNEL_COUNT  // Total number of analog channels
} analog_channel_id_t;

// Analog input configuration
typedef struct {
    uint8_t adc_channel;        // ADC channel number
    uint32_t adc_input;         // ADC input pin (e.g., NRF_SAADC_INPUT_AIN0)
    const char *name;           // Human-readable name
} analog_channel_config_t;

// Calibration data for an analog channel
typedef struct {
    int16_t center_value;       // Center/neutral position value
    int16_t min_value;          // Minimum expected value
    int16_t max_value;          // Maximum expected value
    int16_t deadzone;           // Deadzone around center
    bool is_calibrated;         // True if channel has been calibrated
} analog_calibration_t;

// Filtered analog data
typedef struct {
    int16_t raw_value;          // Raw ADC reading
    float filtered_value;       // Low-pass filtered value
    union {
        int8_t stick_value;     // Stick value (-127 to +127)
        uint8_t trigger_value;  // Trigger value (0 to 255)
    } controller_value;         // Scaled value for controller
    bool in_deadzone;           // True if value is within deadzone
} analog_data_t;

// Analog driver configuration
typedef struct {
    uint16_t resolution_bits;   // ADC resolution (e.g., 12)
    uint32_t gain;              // ADC gain setting
    uint32_t reference;         // ADC reference voltage
    uint32_t acquisition_time;  // ADC acquisition time
    float filter_alpha;         // Low-pass filter coefficient (0.0-1.0)
} analog_config_t;

// Analog driver context
typedef struct {
    bool initialized;
    const struct device *adc_dev;
    analog_config_t config;
    analog_channel_config_t channel_configs[ANALOG_CHANNEL_COUNT];
    struct adc_channel_cfg adc_channel_configs[ANALOG_CHANNEL_COUNT];
    analog_calibration_t calibrations[ANALOG_CHANNEL_COUNT];
    analog_data_t channel_data[ANALOG_CHANNEL_COUNT];
    int16_t raw_buffer[ANALOG_CHANNEL_COUNT];
    bool filter_initialized;
    uint32_t sample_count;
    
    // Thread-based ADC reading
    struct k_thread adc_thread_data;
    k_tid_t adc_thread_tid;
    struct k_mutex data_mutex;  // Protect channel_data access
    bool thread_running;
    bool thread_stop_requested;
} analog_driver_context_t;

// Controller analog data structure (matches main.c format)
typedef struct {
    int8_t stick_x;     // Analog stick X (-127 to +127)
    int8_t stick_y;     // Analog stick Y (-127 to +127)
    uint8_t trigger;    // Trigger value (0 to 255)
} analog_controller_data_t;

// Function prototypes

/**
 * @brief Initialize the analog driver with SAADC offset calibration
 * @param adc_device Pointer to ADC device
 * @return analog_status_t Status of initialization
 */
analog_status_t analog_driver_init(const struct device *adc_device);

/**
 * @brief Start the ADC reading thread
 * @return analog_status_t Status of thread start operation
 */
analog_status_t analog_driver_start_thread(void);

/**
 * @brief Stop the ADC reading thread
 * @return analog_status_t Status of thread stop operation
 */
analog_status_t analog_driver_stop_thread(void);

/**
 * @brief Get controller-format analog data (thread-safe)
 * @param data Pointer to analog_controller_data_t structure to fill
 * @return analog_status_t Status of operation
 */
analog_status_t analog_driver_get_controller_data(analog_controller_data_t *data);

/**
 * @brief Get battery voltage in millivolts (thread-safe)
 * @param voltage_mv Pointer to store battery voltage in mV
 * @return analog_status_t Status of operation
 */
analog_status_t analog_driver_get_battery_voltage(uint16_t *voltage_mv);

/**
 * @brief Get raw ADC value for a specific channel
 * @param channel_id Channel to read
 * @param raw_value Pointer to store raw ADC value
 * @return analog_status_t Status of operation
 */
analog_status_t analog_driver_get_raw_value(analog_channel_id_t channel_id, int16_t *raw_value);

/**
 * @brief Get filtered value for a specific channel
 * @param channel_id Channel to read
 * @param filtered_value Pointer to store filtered value
 * @return analog_status_t Status of operation
 */
analog_status_t analog_driver_get_filtered_value(analog_channel_id_t channel_id, float *filtered_value);

/**
 * @brief Get controller-scaled value for a specific channel
 * @param channel_id Channel to read
 * @param controller_value Pointer to store controller value
 * @return analog_status_t Status of operation
 */
analog_status_t analog_driver_get_controller_value(analog_channel_id_t channel_id, int8_t *controller_value);

/**
 * @brief Calibrate a specific analog channel
 * @param channel_id Channel to calibrate
 * @param center_value Center/neutral position value
 * @param min_value Minimum expected value
 * @param max_value Maximum expected value
 * @param deadzone Deadzone around center
 * @return analog_status_t Status of calibration
 */
analog_status_t analog_driver_calibrate_channel(analog_channel_id_t channel_id, 
                                               int16_t center_value, 
                                               int16_t min_value, 
                                               int16_t max_value, 
                                               int16_t deadzone);

/**
 * @brief Auto-calibrate analog stick channels (call with stick centered)
 * @param samples Number of samples to average for calibration
 * @return analog_status_t Status of auto-calibration
 */
analog_status_t analog_driver_auto_calibrate_sticks(uint16_t samples);

/**
 * @brief Auto-calibrate trigger channel (call with trigger released)
 * @param samples Number of samples to average for calibration
 * @return analog_status_t Status of auto-calibration
 */
analog_status_t analog_driver_auto_calibrate_trigger(uint16_t samples);

/**
 * @brief Set filter coefficient for low-pass filtering
 * @param alpha Filter coefficient (0.0 = heavy filtering, 1.0 = no filtering)
 * @return analog_status_t Status of operation
 */
analog_status_t analog_driver_set_filter_alpha(float alpha);

/**
 * @brief Check if a channel is in its deadzone
 * @param channel_id Channel to check
 * @return bool True if in deadzone, false otherwise
 */
bool analog_driver_is_in_deadzone(analog_channel_id_t channel_id);

/**
 * @brief Get calibration data for a channel
 * @param channel_id Channel to get calibration for
 * @param calibration Pointer to store calibration data
 * @return analog_status_t Status of operation
 */
analog_status_t analog_driver_get_calibration(analog_channel_id_t channel_id, 
                                             analog_calibration_t *calibration);

/**
 * @brief Set calibration data for a channel
 * @param channel_id Channel to set calibration for
 * @param calibration Pointer to calibration data
 * @return analog_status_t Status of operation
 */
analog_status_t analog_driver_set_calibration(analog_channel_id_t channel_id, 
                                             const analog_calibration_t *calibration);

/**
 * @brief Get driver statistics
 * @param total_samples Pointer to store total samples taken
 * @param active_channels Pointer to store number of active channels
 * @return analog_status_t Status of operation
 */
analog_status_t analog_driver_get_stats(uint32_t *total_samples, uint8_t *active_channels);

/**
 * @brief Check if analog driver is properly initialized
 * @return bool True if initialized, false otherwise
 */
bool analog_driver_is_initialized(void);

/**
 * @brief Reset filter state (call when stick positions change rapidly)
 * @return analog_status_t Status of operation
 */
analog_status_t analog_driver_reset_filters(void);

/**
 * @brief Get human-readable name for a channel
 * @param channel_id Channel ID
 * @return const char* Channel name string
 */
const char* analog_driver_get_channel_name(analog_channel_id_t channel_id);

/**
 * @brief Perform a complete calibration sequence for all channels
 * @param delay_ms Delay between calibration steps in milliseconds
 * @return analog_status_t Status of complete calibration
 */
analog_status_t analog_driver_full_calibration(uint32_t delay_ms);

/**
 * @brief Start interactive calibration mode (move stick in circles, pull trigger)
 * @param duration_ms How long to collect calibration data (in milliseconds)
 * @return analog_status_t Status of interactive calibration
 */
analog_status_t analog_driver_interactive_calibration(uint32_t duration_ms);

/**
 * @brief Begin calibration data collection (resets min/max tracking)
 * @return analog_status_t Status of operation
 */
analog_status_t analog_driver_begin_calibration_collection(void);

/**
 * @brief Update calibration with current analog values (call repeatedly during movement)
 * @return analog_status_t Status of operation
 */
analog_status_t analog_driver_update_calibration_data(void);

/**
 * @brief Finalize calibration and apply the collected min/max values
 * @return analog_status_t Status of operation
 */
analog_status_t analog_driver_finalize_calibration(void);

#endif // ANALOG_DRIVER_H
```

## src/button_driver.c
```c
/**
 ******************************************************************************
 * @file    button_driver.c
 * @brief   GPIO Button Driver Library Implementation
 * @author  Controller Team
 * @version V1.0
 * @date    2025
 ******************************************************************************
 */

#include "button_driver.h"
#include "haptic_driver.h" // For haptic feedback
#include <zephyr/logging/log.h>

LOG_MODULE_REGISTER(button_driver, LOG_LEVEL_ERR);

// Global context
static button_driver_context_t g_button_ctx = {0};

// Button name strings for debugging
static const char *button_names[BUTTON_COUNT] = {
    "STICK_CLICK",
    "BUMPER",
    "START",
    "P4",
    "P5",
    "MODE",
    "DPAD_DOWN",
    "DPAD_LEFT",
    "DPAD_RIGHT",
    "DPAD_UP",
    "PAD_CLICK"};

/**
 * @brief Initialize the button driver with GPIO specifications
 */
button_status_t button_driver_init(
    const struct gpio_dt_spec *stick_click,
    const struct gpio_dt_spec *bumper,
    const struct gpio_dt_spec *start,
    const struct gpio_dt_spec *button_p4,
    const struct gpio_dt_spec *button_p5,
    const struct gpio_dt_spec *mode_button,
    const struct gpio_dt_spec *dpad_down,
    const struct gpio_dt_spec *dpad_left,
    const struct gpio_dt_spec *dpad_right,
    const struct gpio_dt_spec *dpad_up,
    const struct gpio_dt_spec *pad_click)
{
    LOG_INF("Initializing button driver...");

    // Clear context
    memset(&g_button_ctx, 0, sizeof(g_button_ctx));

    // Store GPIO specifications
    const struct gpio_dt_spec *gpio_specs[BUTTON_COUNT] = {
        stick_click, // BUTTON_STICK_CLICK
        bumper,      // BUTTON_BUMPER
        start,       // BUTTON_START
        button_p4,   // BUTTON_P4
        button_p5,   // BUTTON_P5
        mode_button, // BUTTON_MODE
        dpad_down,   // BUTTON_DPAD_DOWN
        dpad_left,   // BUTTON_DPAD_LEFT
        dpad_right,  // BUTTON_DPAD_RIGHT
        dpad_up,     // BUTTON_DPAD_UP
        pad_click    // BUTTON_PAD_CLICK
    };

    // Configure each button
    for (int i = 0; i < BUTTON_COUNT; i++)
    {
        if (!gpio_specs[i])
        {
            LOG_ERR("Button %d (%s) GPIO spec is NULL", i, button_names[i]);
            return BUTTON_STATUS_ERROR;
        }

        // Store configuration
        g_button_ctx.button_configs[i].gpio_spec = gpio_specs[i];
        g_button_ctx.button_configs[i].active_low = (gpio_specs[i]->dt_flags & GPIO_ACTIVE_LOW) != 0;
        g_button_ctx.button_configs[i].pull_up = true; // All buttons use pull-up

        // Configure GPIO
        int ret = gpio_pin_configure_dt(gpio_specs[i], GPIO_INPUT | GPIO_PULL_UP);
        if (ret != 0)
        {
            LOG_ERR("Failed to configure button %d (%s): %d", i, button_names[i], ret);
            return BUTTON_STATUS_ERROR;
        }

        // Initialize button state
        g_button_ctx.button_states[i].current_state = false;
        g_button_ctx.button_states[i].previous_state = false;
        g_button_ctx.button_states[i].press_time = 0;
        g_button_ctx.button_states[i].release_time = 0;
        g_button_ctx.button_states[i].is_pressed = false;
        g_button_ctx.button_states[i].just_pressed = false;
        g_button_ctx.button_states[i].just_released = false;

        LOG_INF("Button %d (%s) configured successfully", i, button_names[i]);
    }

    // Enable haptic feedback by default
    g_button_ctx.haptic_feedback_enabled = true;
    g_button_ctx.initialized = true;
    g_button_ctx.scan_count = 0;

    LOG_INF("Button driver initialized with %d buttons", BUTTON_COUNT);
    return BUTTON_STATUS_OK;
}

/**
 * @brief Scan all buttons and update their states
 */
button_status_t button_driver_scan(void)
{
    if (!g_button_ctx.initialized)
    {
        return BUTTON_STATUS_NOT_INITIALIZED;
    }

    uint32_t current_time = k_uptime_get_32();
    bool any_button_just_pressed = false;

    // Scan each button
    for (int i = 0; i < BUTTON_COUNT; i++)
    {
        button_state_t *state = &g_button_ctx.button_states[i];
        const button_config_t *config = &g_button_ctx.button_configs[i];

        // Store previous state
        state->previous_state = state->current_state;

        // Read current GPIO state
        int gpio_value = gpio_pin_get_dt(config->gpio_spec);
        if (gpio_value < 0)
        {
            LOG_WRN("Failed to read button %d (%s): %d", i, button_names[i], gpio_value);
            continue;
        }

        // Convert GPIO value to button state (considering active_low)
        if (config->active_low)
        {
            state->current_state = !(gpio_value == 0); // Active low: 0 = pressed
        }
        else
        {
            state->current_state = !(gpio_value == 1); // Active high: 1 = pressed
        }

        // Update edge detection flags
        state->just_pressed = (!state->previous_state && state->current_state);
        state->just_released = (state->previous_state && !state->current_state);
        state->is_pressed = state->current_state;

        // Update timing
        if (state->just_pressed)
        {
            state->press_time = current_time;
            any_button_just_pressed = true;
        }
        else if (state->just_released)
        {
            state->release_time = current_time;
        }
    }

    // Provide haptic feedback for button presses
    // if (any_button_just_pressed && g_button_ctx.haptic_feedback_enabled)
    // {
    //     if (haptic_is_available())
    //     {
    //         haptic_play_pattern(HAPTIC_PATTERN_BUTTON_PRESS);
    //     }
    // }

    g_button_ctx.scan_count++;
    return BUTTON_STATUS_OK;
}

/**
 * @brief Get current button data in controller format
 */
button_status_t button_driver_get_data(button_data_t *data)
{
    if (!g_button_ctx.initialized)
    {
        return BUTTON_STATUS_NOT_INITIALIZED;
    }

    if (!data)
    {
        return BUTTON_STATUS_ERROR;
    }

    // Clear data structure
    data->buttons = 0;
    data->flags = 0;

    // Map button states to controller data format
    // Buttons format: Start/Select(0x80), Trackpad Click(0x40), Stick Click(0x20), Bumper(0x10), A/Down(0x08), B/Right(0x04), X/Left(0x02), Y/Up(0x01)
    if (g_button_ctx.button_states[BUTTON_START].is_pressed) {
        data->buttons |= 0x80; // Bit 7: Start/Select
    }
    if (g_button_ctx.button_states[BUTTON_PAD_CLICK].is_pressed) {
        data->buttons |= 0x40; // Bit 6: Trackpad Click
    }
    if (g_button_ctx.button_states[BUTTON_STICK_CLICK].is_pressed) {
        data->buttons |= 0x20; // Bit 5: Stick click
    }
    if (g_button_ctx.button_states[BUTTON_BUMPER].is_pressed) {
        data->buttons |= 0x10; // Bit 4: Bumper (L1)
    }
    if (g_button_ctx.button_states[BUTTON_DPAD_DOWN].is_pressed) {
        data->buttons |= 0x08; // Bit 3: A/Down
    }
    if (g_button_ctx.button_states[BUTTON_DPAD_RIGHT].is_pressed) {
        data->buttons |= 0x04; // Bit 2: B/Right
    }
    if (g_button_ctx.button_states[BUTTON_DPAD_LEFT].is_pressed) {
        data->buttons |= 0x02; // Bit 1: X/Left
    }
    if (g_button_ctx.button_states[BUTTON_DPAD_UP].is_pressed) {
        data->buttons |= 0x01; // Bit 0: Y/Up
    }

    // Flags format: ID(0x80), Mode1(0x40), Mode2(0x20), TBD(0x10), TBD(0x08), TrackpadTap(0x04), P4(0x02), P5(0x01)
    // Note: You might want to set ID bit if this is a specific controller
    // data->flags |= 0x80; // ID bit - uncomment if needed
    
    if (g_button_ctx.button_states[BUTTON_MODE].is_pressed) {
        data->flags |= 0x40; // Bit 6: Mode1 button
    }
    // If you have a second mode button, map it to:
    // data->flags |= 0x20; // Bit 5: Mode2 button
    
    // Bit 4 and 3 are marked as TBD (To Be Determined)
    
    // Note: TrackpadTap might be different from TrackpadClick - you may need to distinguish these
    // For now, I'll leave this bit available for a different trackpad gesture
    // data->flags |= 0x04; // Bit 2: TrackpadTap (different from click?)
    
    if (g_button_ctx.button_states[BUTTON_P4].is_pressed) {
        data->flags |= 0x02; // Bit 1: P4 button
    }
    if (g_button_ctx.button_states[BUTTON_P5].is_pressed) {
        data->flags |= 0x01; // Bit 0: P5 button
    }

    // LOG_INF("Buttons: %c%c%c%c%c%c%c%c (0x%02X) Flags: %c%c%c%c%c%c%c%c (0x%02X)",
    //         (data->buttons & 0x80) ? '1' : '0',
    //         (data->buttons & 0x40) ? '1' : '0',
    //         (data->buttons & 0x20) ? '1' : '0',
    //         (data->buttons & 0x10) ? '1' : '0',
    //         (data->buttons & 0x08) ? '1' : '0',
    //         (data->buttons & 0x04) ? '1' : '0',
    //         (data->buttons & 0x02) ? '1' : '0',
    //         (data->buttons & 0x01) ? '1' : '0',
    //         data->buttons,
    //         (data->flags & 0x80) ? '1' : '0',
    //         (data->flags & 0x40) ? '1' : '0',
    //         (data->flags & 0x20) ? '1' : '0',
    //         (data->flags & 0x10) ? '1' : '0',
    //         (data->flags & 0x08) ? '1' : '0',
    //         (data->flags & 0x04) ? '1' : '0',
    //         (data->flags & 0x02) ? '1' : '0',
    //         (data->flags & 0x01) ? '1' : '0',
    //         data->flags);

    // Store current data in context
    g_button_ctx.current_data = *data;

    return BUTTON_STATUS_OK;
}

/**
 * @brief Check if a specific button is currently pressed
 */
bool button_driver_is_pressed(button_id_t button_id)
{
    if (!g_button_ctx.initialized || button_id >= BUTTON_COUNT)
    {
        return false;
    }

    return g_button_ctx.button_states[button_id].is_pressed;
}

/**
 * @brief Check if a specific button was just pressed (edge detection)
 */
bool button_driver_just_pressed(button_id_t button_id)
{
    if (!g_button_ctx.initialized || button_id >= BUTTON_COUNT)
    {
        return false;
    }

    return g_button_ctx.button_states[button_id].just_pressed;
}

/**
 * @brief Check if a specific button was just released (edge detection)
 */
bool button_driver_just_released(button_id_t button_id)
{
    if (!g_button_ctx.initialized || button_id >= BUTTON_COUNT)
    {
        return false;
    }

    return g_button_ctx.button_states[button_id].just_released;
}

/**
 * @brief Get the duration a button has been pressed
 */
uint32_t button_driver_get_press_duration(button_id_t button_id)
{
    if (!g_button_ctx.initialized || button_id >= BUTTON_COUNT)
    {
        return 0;
    }

    const button_state_t *state = &g_button_ctx.button_states[button_id];

    if (!state->is_pressed)
    {
        return 0; // Button not currently pressed
    }

    return k_uptime_get_32() - state->press_time;
}

/**
 * @brief Enable or disable haptic feedback for button presses
 */
button_status_t button_driver_set_haptic_feedback(bool enable)
{
    if (!g_button_ctx.initialized)
    {
        return BUTTON_STATUS_NOT_INITIALIZED;
    }

    g_button_ctx.haptic_feedback_enabled = enable;
    LOG_INF("Button haptic feedback %s", enable ? "enabled" : "disabled");

    return BUTTON_STATUS_OK;
}

/**
 * @brief Get current button statistics
 */
button_status_t button_driver_get_stats(uint32_t *total_scans, uint8_t *active_buttons)
{
    if (!g_button_ctx.initialized)
    {
        return BUTTON_STATUS_NOT_INITIALIZED;
    }

    if (total_scans)
    {
        *total_scans = g_button_ctx.scan_count;
    }

    if (active_buttons)
    {
        uint8_t count = 0;
        for (int i = 0; i < BUTTON_COUNT; i++)
        {
            if (g_button_ctx.button_states[i].is_pressed)
            {
                count++;
            }
        }
        *active_buttons = count;
    }

    return BUTTON_STATUS_OK;
}

/**
 * @brief Check if button driver is properly initialized
 */
bool button_driver_is_initialized(void)
{
    return g_button_ctx.initialized;
}

/**
 * @brief Reset all button states and statistics
 */
button_status_t button_driver_reset(void)
{
    if (!g_button_ctx.initialized)
    {
        return BUTTON_STATUS_NOT_INITIALIZED;
    }

    // Reset all button states
    for (int i = 0; i < BUTTON_COUNT; i++)
    {
        button_state_t *state = &g_button_ctx.button_states[i];
        state->current_state = false;
        state->previous_state = false;
        state->press_time = 0;
        state->release_time = 0;
        state->is_pressed = false;
        state->just_pressed = false;
        state->just_released = false;
    }

    // Reset statistics
    g_button_ctx.scan_count = 0;

    // Clear current data
    g_button_ctx.current_data.buttons = 0;
    g_button_ctx.current_data.flags = 0;

    LOG_INF("Button driver state reset");
    return BUTTON_STATUS_OK;
}

/**
 * @brief Get human-readable name for a button ID
 */
const char *button_driver_get_button_name(button_id_t button_id)
{
    if (button_id >= BUTTON_COUNT)
    {
        return "UNKNOWN";
    }

    return button_names[button_id];
}
```

## src/controller_storage.c
```c
/*
 * Controller Storage Module - NVS-based Configuration Storage
 * 
 * This module provides persistent storage for controller configuration data
 * including calibrations, custom bindings, and user preferences.
 */

#include <zephyr/kernel.h>
#include <zephyr/settings/settings.h>
#include <zephyr/logging/log.h>
#include <string.h>

#include "controller_storage.h"

LOG_MODULE_REGISTER(storage, LOG_LEVEL_ERR);

// Storage is ready flag
static bool storage_initialized = false;

// Current configuration in RAM (cached for performance)
static controller_calibration_t current_calibration;
static controller_bindings_t current_bindings;
static controller_preferences_t current_preferences;

// Settings subsystem handlers
static int calibration_set(const char *key, size_t len, settings_read_cb read_cb, void *cb_arg)
{
    if (len != sizeof(controller_calibration_t)) {
        LOG_WRN("Calibration data size mismatch: expected %zu, got %zu", 
                sizeof(controller_calibration_t), len);
        return -EINVAL;
    }
    
    int ret = read_cb(cb_arg, &current_calibration, sizeof(current_calibration));
    if (ret >= 0) {
        LOG_INF("Loaded calibration data from flash");
    }
    return ret;
}

static int bindings_set(const char *key, size_t len, settings_read_cb read_cb, void *cb_arg)
{
    if (len != sizeof(controller_bindings_t)) {
        LOG_WRN("Bindings data size mismatch: expected %zu, got %zu", 
                sizeof(controller_bindings_t), len);
        return -EINVAL;
    }
    
    int ret = read_cb(cb_arg, &current_bindings, sizeof(current_bindings));
    if (ret >= 0) {
        LOG_INF("Loaded bindings data from flash");
    }
    return ret;
}

static int preferences_set(const char *key, size_t len, settings_read_cb read_cb, void *cb_arg)
{
    if (len != sizeof(controller_preferences_t)) {
        LOG_WRN("Preferences data size mismatch: expected %zu, got %zu", 
                sizeof(controller_preferences_t), len);
        return -EINVAL;
    }
    
    int ret = read_cb(cb_arg, &current_preferences, sizeof(current_preferences));
    if (ret >= 0) {
        LOG_INF("Loaded preferences data from flash");
    }
    return ret;
}

// Settings handler registration
SETTINGS_STATIC_HANDLER_DEFINE(controller, "controller", NULL, calibration_set, NULL, NULL);
SETTINGS_STATIC_HANDLER_DEFINE(bindings, "bindings", NULL, bindings_set, NULL, NULL);
SETTINGS_STATIC_HANDLER_DEFINE(preferences, "preferences", NULL, preferences_set, NULL, NULL);

int controller_storage_init(void)
{
    int ret;
    
    LOG_INF("Initializing controller storage...");
    
    // Initialize settings subsystem
    ret = settings_subsys_init();
    if (ret) {
        LOG_ERR("Failed to initialize settings subsystem: %d", ret);
        return ret;
    }
    
    // Initialize with defaults first
    controller_storage_init_default_calibration(&current_calibration);
    controller_storage_init_default_bindings(&current_bindings);
    controller_storage_init_default_preferences(&current_preferences);
    
    // Load settings from flash (will override defaults if found)
    ret = settings_load();
    if (ret) {
        LOG_WRN("Failed to load settings from flash: %d (using defaults)", ret);
        // Don't return error - using defaults is OK
    }
    
    storage_initialized = true;
    LOG_INF("Controller storage initialized successfully");
    
    return 0;
}

int controller_storage_save_calibration(const controller_calibration_t *cal)
{
    if (!storage_initialized) {
        LOG_ERR("Storage not initialized");
        return -ENODEV;
    }
    
    if (!cal) {
        return -EINVAL;
    }
    
    int ret = settings_save_one("controller/" STORAGE_KEY_CALIBRATION, cal, sizeof(*cal));
    if (ret == 0) {
        // Update cached copy
        memcpy(&current_calibration, cal, sizeof(current_calibration));
        LOG_INF("Calibration data saved to flash");
    } else {
        LOG_ERR("Failed to save calibration data: %d", ret);
    }
    
    return ret;
}

int controller_storage_load_calibration(controller_calibration_t *cal)
{
    if (!storage_initialized) {
        LOG_ERR("Storage not initialized");
        return -ENODEV;
    }
    
    if (!cal) {
        return -EINVAL;
    }
    
    // Return cached copy (already loaded during init)
    memcpy(cal, &current_calibration, sizeof(*cal));
    return 0;
}

int controller_storage_save_bindings(const controller_bindings_t *bindings)
{
    if (!storage_initialized) {
        LOG_ERR("Storage not initialized");
        return -ENODEV;
    }
    
    if (!bindings) {
        return -EINVAL;
    }
    
    int ret = settings_save_one("bindings/" STORAGE_KEY_BINDINGS, bindings, sizeof(*bindings));
    if (ret == 0) {
        // Update cached copy
        memcpy(&current_bindings, bindings, sizeof(current_bindings));
        LOG_INF("Bindings data saved to flash");
    } else {
        LOG_ERR("Failed to save bindings data: %d", ret);
    }
    
    return ret;
}

int controller_storage_load_bindings(controller_bindings_t *bindings)
{
    if (!storage_initialized) {
        LOG_ERR("Storage not initialized");
        return -ENODEV;
    }
    
    if (!bindings) {
        return -EINVAL;
    }
    
    // Return cached copy (already loaded during init)
    memcpy(bindings, &current_bindings, sizeof(*bindings));
    return 0;
}

int controller_storage_save_preferences(const controller_preferences_t *prefs)
{
    if (!storage_initialized) {
        LOG_ERR("Storage not initialized");
        return -ENODEV;
    }
    
    if (!prefs) {
        return -EINVAL;
    }
    
    int ret = settings_save_one("preferences/" STORAGE_KEY_PREFERENCES, prefs, sizeof(*prefs));
    if (ret == 0) {
        // Update cached copy
        memcpy(&current_preferences, prefs, sizeof(current_preferences));
        LOG_INF("Preferences data saved to flash");
    } else {
        LOG_ERR("Failed to save preferences data: %d", ret);
    }
    
    return ret;
}

int controller_storage_load_preferences(controller_preferences_t *prefs)
{
    if (!storage_initialized) {
        LOG_ERR("Storage not initialized");
        return -ENODEV;
    }
    
    if (!prefs) {
        return -EINVAL;
    }
    
    // Return cached copy (already loaded during init)
    memcpy(prefs, &current_preferences, sizeof(*prefs));
    return 0;
}

int controller_storage_factory_reset(void)
{
    if (!storage_initialized) {
        LOG_ERR("Storage not initialized");
        return -ENODEV;
    }
    
    LOG_WRN("Performing factory reset - all stored data will be lost!");
    
    int ret = 0;
    
    // Delete all settings
    ret |= settings_delete("controller/" STORAGE_KEY_CALIBRATION);
    ret |= settings_delete("bindings/" STORAGE_KEY_BINDINGS);
    ret |= settings_delete("preferences/" STORAGE_KEY_PREFERENCES);
    
    if (ret == 0) {
        // Reset cached copies to defaults
        controller_storage_init_default_calibration(&current_calibration);
        controller_storage_init_default_bindings(&current_bindings);
        controller_storage_init_default_preferences(&current_preferences);
        
        LOG_INF("Factory reset completed successfully");
    } else {
        LOG_ERR("Factory reset failed: %d", ret);
    }
    
    return ret;
}

int controller_storage_get_stats(size_t *used_bytes, size_t *free_bytes)
{
    // Note: Zephyr settings doesn't provide direct storage stats
    // This is a placeholder implementation
    if (used_bytes) {
        *used_bytes = sizeof(controller_calibration_t) + 
                     sizeof(controller_bindings_t) + 
                     sizeof(controller_preferences_t);
    }
    
    if (free_bytes) {
        *free_bytes = 4096; // Estimate - actual depends on flash partition
    }
    
    return 0;
}

void controller_storage_init_default_calibration(controller_calibration_t *cal)
{
    if (!cal) return;
    
    memset(cal, 0, sizeof(*cal));
    
    // Default analog stick calibration (assuming 12-bit ADC, center at 2048)
    cal->stick_center_x = 2048;
    cal->stick_center_y = 2048;
    cal->stick_min_x = 0;
    cal->stick_max_x = 4095;
    cal->stick_min_y = 0;
    cal->stick_max_y = 4095;
    cal->stick_deadzone = 200;  // ~5% deadzone
    
    // Default trigger calibration
    cal->trigger_min = 0;
    cal->trigger_max = 4095;
    
    // IMU offsets (start at zero - will be calibrated)
    cal->accel_offset_x = 0;
    cal->accel_offset_y = 0;
    cal->accel_offset_z = 0;
    cal->gyro_offset_x = 0;
    cal->gyro_offset_y = 0;
    cal->gyro_offset_z = 0;
    
    // Trackpad sensitivity
    cal->trackpad_sensitivity = 100; // Default sensitivity
    
    // All calibrations start as uncalibrated
    cal->stick_calibrated = false;
    cal->trigger_calibrated = false;
    cal->imu_calibrated = false;
    cal->trackpad_calibrated = false;
    
    LOG_DBG("Initialized default calibration");
}

void controller_storage_init_default_bindings(controller_bindings_t *bindings)
{
    if (!bindings) return;
    
    memset(bindings, 0, sizeof(*bindings));
    
    // Default button mapping (1:1 mapping)
    for (int i = 0; i < 16; i++) {
        bindings->button_map[i] = i;
    }
    
    // Default modes
    bindings->trigger_mode = 0;     // Analog
    bindings->stick_mode = 0;       // Gamepad
    bindings->trackpad_mode = 0;    // Mouse
    
    // Default orientations
    bindings->invert_stick_x = false;
    bindings->invert_stick_y = false;
    bindings->swap_sticks = false;
    
    LOG_DBG("Initialized default bindings");
}

void controller_storage_init_default_preferences(controller_preferences_t *prefs)
{
    if (!prefs) return;
    
    memset(prefs, 0, sizeof(*prefs));
    
    // Default display and LED settings
    prefs->display_brightness = 128;  // 50% brightness
    prefs->led_brightness = 64;       // 25% brightness
    
    // Default power settings
    prefs->sleep_enabled = true;
    prefs->sleep_timeout_ms = 300000; // 5 minutes
    
    // Default controller ID (will be overridden by compile-time setting)
    prefs->controller_id = 0;  // RIGHT
    
    // Default name
    strcpy(prefs->controller_name, "Controller");
    
    LOG_DBG("Initialized default preferences");
}
```
