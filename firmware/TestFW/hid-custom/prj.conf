## CMakeLists.txt
```
# SPDX-License-Identifier: Apache-2.0

cmake_minimum_required(VERSION 3.20.0)
find_package(Zephyr REQUIRED HINTS $ENV{ZEPHYR_BASE})
project(hid-custom)

include(${ZEPHYR_BASE}/samples/subsys/usb/common/common.cmake)
target_sources(app PRIVATE 
    src/main.c
    src/controller_esb.c
    src/usb_hid_sinput.c
)
```

## prj.conf
```kconfig
CONFIG_USB_DEVICE_STACK_NEXT=y
CONFIG_USB_DEVICE_STACK=n
CONFIG_USBD_HID_SUPPORT=y

CONFIG_LOG=y
CONFIG_USBD_LOG_LEVEL_WRN=y
CONFIG_USBD_HID_LOG_LEVEL_WRN=y
CONFIG_UDC_DRIVER_LOG_LEVEL_WRN=y
CONFIG_SAMPLE_USBD_PID=0x10C6

CONFIG_SAMPLE_USBD_MANUFACTURER="TommyB's"
CONFIG_SAMPLE_USBD_PRODUCT="OpenSplitDeck"
CONFIG_SAMPLE_USBD_MAX_POWER=250
CONFIG_SAMPLE_USBD_20_EXTENSION_DESC=y

CONFIG_GPIO=y
CONFIG_INPUT=y

# Enhanced ShockBurst configuration
CONFIG_ESB=y

# Increase main thread stack size for dual controller processing
CONFIG_MAIN_STACK_SIZE=8192

# High priority system workqueue to prevent ESB blocking
CONFIG_SYSTEM_WORKQUEUE_PRIORITY=-1
CONFIG_MAIN_THREAD_PRIORITY=7
```

## src/main.c
```c
#include <stdint.h>
#include <string.h>
#include <zephyr/kernel.h>
#include <zephyr/device.h>
#include <zephyr/drivers/gpio.h>
#include "controller_esb.h"
#include "usb_hid_sinput.h"

#include <zephyr/logging/log.h>
LOG_MODULE_REGISTER(main, LOG_LEVEL_DBG);

static const struct gpio_dt_spec led0 = GPIO_DT_SPEC_GET(DT_ALIAS(led0), gpios);

// Haptics callback - forwards S-Input haptics to ESB controllers
static void haptics_callback(uint8_t left_amp, uint8_t right_amp)
{
    controller_esb_set_haptics(left_amp, right_amp);
}

// Helper function to map a value from one range to another
long map(long x, long in_min, long in_max, long out_min, long out_max)
{
    return (x - in_min) * (out_max - out_min) / (in_max - in_min) + out_min;
}

// Low-pass filter for gyro data (removes high-frequency noise)
static int16_t gyro_lowpass_filter(int16_t new_value, int16_t prev_value, float alpha)
{
    // alpha = 0.0 to 1.0, lower values = more filtering (smoother but slower response)
    // Typical values: 0.1 to 0.3 for good filtering
    return (int16_t)(alpha * new_value + (1.0f - alpha) * prev_value);
}

// Apply deadzone to joystick input (removes drift at center)
static int16_t apply_joystick_deadzone(int8_t value, int8_t deadzone)
{
    if (value > -deadzone && value < deadzone) {
        return 0;  // Within deadzone - snap to center
    }
    // Scale from int8_t to int16_t
    return (int16_t)value * 256;
}

// Convert controller data to S-Input HID reports (using separated controller states)
static void process_controller_data(const struct device *hid_dev)
{
    uint32_t func_start = k_uptime_get_32();
    
    // Get SEPARATE controller states - no more shared state corruption!
    simple_controller_state_t *left_controller = controller_esb_get_left_state();
    simple_controller_state_t *right_controller = controller_esb_get_right_state();

    // DEBUG: Log if we have any controller data
    static uint32_t last_debug_log = 0;
    uint32_t now = k_uptime_get_32();
    if (now - last_debug_log > 1000) { // Log every second
        LOG_INF("L_recv:%d R_recv:%d", left_controller->data_received, right_controller->data_received);
        if (left_controller->data_received) {
            LOG_INF("L: btns:0x%02X flags:0x%02X stick:%d,%d trig:%d pad:%d,%d", 
                    left_controller->buttons, left_controller->flags,
                    left_controller->stickX, left_controller->stickY,
                    left_controller->trigger, left_controller->padX, left_controller->padY);
        }
        if (right_controller->data_received) {
            LOG_INF("R: btns:0x%02X flags:0x%02X stick:%d,%d trig:%d pad:%d,%d",
                    right_controller->buttons, right_controller->flags,
                    right_controller->stickX, right_controller->stickY,
                    right_controller->trigger, right_controller->padX, right_controller->padY);
        }
        last_debug_log = now;
    }

    // Static S-Input report structure - initialized to zero on first call
    static sinput_input_report_t report;
    static bool report_initialized = false;
    
    if (!report_initialized) {
        memset(&report, 0, sizeof(report));
        report.report_id = SINPUT_INPUT_REPORT_ID;
        report.plug_status = 0x01;  // Bit 0: USB connected
        report.charge_percent = 100;  // Always full when USB powered
        report_initialized = true;
    }
    
    // Static variables for touchpad smoothing with multi-frame interpolation
    static uint16_t raw_touch1_x = 0, raw_touch1_y = 0;
    static uint16_t raw_touch2_x = 0, raw_touch2_y = 0;
    static uint16_t last_touch1_x = 0, last_touch1_y = 0;
    static uint16_t last_touch2_x = 0, last_touch2_y = 0;
    static bool last_touch1_active = false;
    static bool last_touch2_active = false;
    
    // Multi-frame smoothing for touchpad (even smoother than before)
    static int16_t smooth_touchpad_x = 0, smooth_touchpad_y = 0;
    static bool was_touching = false;  // Track if we were touching last frame
    static const float touchpad_alpha = 0.2f; // Very heavy smoothing (0.1-0.2 for touchpads)
    
    // Static variables for gyro low-pass filtering
    static int16_t prev_gyro_x = 0, prev_gyro_y = 0, prev_gyro_z = 0;
    static const float gyro_alpha = 0.08f; // Lower = more filtering, less noise (0.1-0.3 typical)
    
    // Static variables for accelerometer low-pass filtering
    static int16_t prev_accel_x = 0, prev_accel_y = 0, prev_accel_z = 0;
    static const float accel_alpha = 0.5f; // Accel can be slightly faster response than gyro
    
    // Temporary variables for touchpad state within this function
    bool touch1_active = false;
    bool touch2_active = false;
    
    // Clear touchpad button (will be set if either controller presses it)
    report.button_touchpad_1 = 0;
    
    // Process LEFT controller data independently
    if (left_controller->data_received)
    {
        // Left analog stick (convert int8_t -128 to 127 → int16_t -32768 to 32767, with deadzone)
        report.left_x = apply_joystick_deadzone(left_controller->stickX, 5);
        report.left_y = apply_joystick_deadzone(left_controller->stickY, 5);
        
        // Left trigger (convert uint8_t 0-255 → int16_t -32768 to 32512, centered at 0)
        // Map: 0 → -32768 (not pressed), 128 → 0 (half), 255 → 32512 (full)
        report.trigger_l = ((int16_t)left_controller->trigger - 128) * 256;

        // Left touchpad (map to left half of single touchpad: 0-479 X range)
        touch2_active = (left_controller->padX != 0 || left_controller->padY != 0);
        raw_touch2_x = touch2_active ? map(left_controller->padY, 0, 1023, 479, 0) : 0;  // Inverted X
        raw_touch2_y = touch2_active ? map(left_controller->padX, 0, 1023, 0, 942) : 0;

        // D-pad buttons (S-Input format - individual bits, NOT encoded)
        report.dpad_up = (left_controller->buttons & 0x01) ? 1 : 0;
        report.dpad_down = (left_controller->buttons & 0x08) ? 1 : 0;
        report.dpad_left = (left_controller->buttons & 0x02) ? 1 : 0;
        report.dpad_right = (left_controller->buttons & 0x04) ? 1 : 0;

        // Left controller buttons
        report.button_l_shoulder = (left_controller->buttons & 0x10) ? 1 : 0;
        report.button_l_trigger = (left_controller->trigger > 128) ? 1 : 0;
        report.button_stick_left = (left_controller->buttons & 0x20) ? 1 : 0;
        
        // Left touchpad click -> touchpad_1 button (combined, only 1 physical touchpad)
        if (left_controller->buttons & 0x40) {
            report.button_touchpad_1 = 1;
            LOG_DBG("Left touchpad clicked");
        }
        
        report.button_select = (left_controller->buttons & 0x80) ? 1 : 0;
        report.button_guide = (left_controller->flags & 0x40) ? 1 : 0;
        
        // Left back paddles (B4, B5 flags)
        report.button_l_paddle_1 = (left_controller->flags & 0x01) ? 1 : 0;  // B4
        report.button_l_paddle_2 = (left_controller->flags & 0x02) ? 1 : 0;  // B5
    }

    // Process RIGHT controller data independently
    if (right_controller->data_received)
    {
        // Right analog stick (convert int8_t -128 to 127 → int16_t -32768 to 32767, with deadzone)
        report.right_x = apply_joystick_deadzone(right_controller->stickX, 5);
        report.right_y = apply_joystick_deadzone(right_controller->stickY, 5);
        
        // Right trigger (convert uint8_t 0-255 → int16_t -32768 to 32512, centered at 0)
        // Map: 0 → -32768 (not pressed), 128 → 0 (half), 255 → 32512 (full)
        report.trigger_r = ((int16_t)right_controller->trigger - 128) * 256;

        // IMU from right controller with low-pass filtering
        // Scale accelerometer down - raw values seem to be in a higher range than expected
        // Divide by 4 to bring into reasonable range (adjust if needed)
        int16_t raw_accel_x = right_controller->accelX / 800;
        int16_t raw_accel_y = right_controller->accelZ / 800;
        int16_t raw_accel_z = right_controller->accelY / 800;
        
        report.accel_x = gyro_lowpass_filter(raw_accel_x, prev_accel_x, accel_alpha);
        report.accel_y = gyro_lowpass_filter(raw_accel_y, prev_accel_y, accel_alpha);
        report.accel_z = gyro_lowpass_filter(raw_accel_z, prev_accel_z, accel_alpha);
        
        prev_accel_x = report.accel_x;
        prev_accel_y = report.accel_y;
        prev_accel_z = report.accel_z;
        
        // Gyro with low-pass filtering to reduce noise
        // Controller axes: gyroX=forward/back, gyroY=steering, gyroZ=left/right tilt
        // Report axes: gyro_x=pitch(forward/back), gyro_y=yaw(steering), gyro_z=roll(left/right)
        int16_t raw_gyro_x = right_controller->gyroX * -5; // forward/back (inverted)
        int16_t raw_gyro_y = right_controller->gyroZ * 5; // left/right tilt
        int16_t raw_gyro_z = right_controller->gyroY * -5; // steer
        
        report.gyro_x = gyro_lowpass_filter(raw_gyro_x, prev_gyro_x, gyro_alpha);
        report.gyro_y = gyro_lowpass_filter(raw_gyro_y, prev_gyro_y, gyro_alpha);
        report.gyro_z = gyro_lowpass_filter(raw_gyro_z, prev_gyro_z, gyro_alpha);
        
        prev_gyro_x = report.gyro_x;
        prev_gyro_y = report.gyro_y;
        prev_gyro_z = report.gyro_z;

        // Right touchpad (map to right half of single touchpad: 480-959 X range)
        touch1_active = (right_controller->padX != 0 || right_controller->padY != 0);
        raw_touch1_x = touch1_active ? map(right_controller->padY, 0, 1023, 480, 959) : 0;
        raw_touch1_y = touch1_active ? map(right_controller->padX, 0, 1023, 942, 0) : 0;  // Inverted Y

        // Right controller face buttons
        report.button_north = (right_controller->buttons & 0x01) ? 1 : 0;
        report.button_west = (right_controller->buttons & 0x02) ? 1 : 0;
        report.button_east = (right_controller->buttons & 0x04) ? 1 : 0;
        report.button_south = (right_controller->buttons & 0x08) ? 1 : 0;
        
        // Right controller buttons
        report.button_r_shoulder = (right_controller->buttons & 0x10) ? 1 : 0;
        report.button_r_trigger = (right_controller->trigger > 128) ? 1 : 0;
        report.button_stick_right = (right_controller->buttons & 0x20) ? 1 : 0;
        
        // Right touchpad click -> touchpad_1 button (combined, only 1 physical touchpad)
        if (right_controller->buttons & 0x40) {
            report.button_touchpad_1 = 1;
            LOG_DBG("Right touchpad clicked");
        }
        
        report.button_start = (right_controller->buttons & 0x80) ? 1 : 0;
        
        // Right back paddles (B4, B5 flags)
        report.button_r_paddle_1 = (right_controller->flags & 0x01) ? 1 : 0;  // B4
        report.button_r_paddle_2 = (right_controller->flags & 0x02) ? 1 : 0;  // B5
        
        // Guide button can be set by either controller
        if (right_controller->flags & 0x40)
        {
            report.button_guide = 1;
        }
    }
    
    // Combine both touchpads into single touchpad report (outside controller blocks)
    // Recalculate from raw values with small deadzone to detect true "no touch"
    const uint16_t TOUCH_DEADZONE = 10;  // Ignore values below this threshold
    touch1_active = (raw_touch1_x > TOUCH_DEADZONE || raw_touch1_y > TOUCH_DEADZONE);
    touch2_active = (raw_touch2_x > TOUCH_DEADZONE || raw_touch2_y > TOUCH_DEADZONE);
    
    // Use whichever touchpad is active (right takes priority if both)
    uint16_t active_x = touch1_active ? raw_touch1_x : (touch2_active ? raw_touch2_x : 0);
    uint16_t active_y = touch1_active ? raw_touch1_y : (touch2_active ? raw_touch2_y : 0);
    
    if (touch1_active || touch2_active)
    {
        // Convert raw coordinates to centered int16 range
        int16_t target_x = (int16_t)(((int32_t)active_x - 479) * 65535 / 959);
        int16_t target_y = (int16_t)(((int32_t)active_y - 471) * 65535 / 942);
        
        // On first touch, snap to position immediately (no filter from 0)
        if (!was_touching) {
            smooth_touchpad_x = target_x;
            smooth_touchpad_y = target_y;
            was_touching = true;
        } else {
            // Apply heavy low-pass filter for super smooth tracking
            smooth_touchpad_x = gyro_lowpass_filter(target_x, smooth_touchpad_x, touchpad_alpha);
            smooth_touchpad_y = gyro_lowpass_filter(target_y, smooth_touchpad_y, touchpad_alpha);
        }
        
        report.touchpad_1_x = smooth_touchpad_x;
        report.touchpad_1_y = smooth_touchpad_y;
        report.touchpad_1_pressure = 255;
    }
    else
    {
        // No touch - immediately reset to zero (no gradual fade)
        smooth_touchpad_x = 0;
        smooth_touchpad_y = 0;
        was_touching = false;
        report.touchpad_1_x = 0;
        report.touchpad_1_y = 0;
        report.touchpad_1_pressure = 0;
    }
    
    // Update history
    last_touch1_x = raw_touch1_x;
    last_touch1_y = raw_touch1_y;
    last_touch1_active = touch1_active;
    last_touch2_x = raw_touch2_x;
    last_touch2_y = raw_touch2_y;
    last_touch2_active = touch2_active;
    
    // Clear touchpad 2 (not used in single-touchpad mode)
    report.touchpad_2_x = 0;
    report.touchpad_2_y = 0;
    report.touchpad_2_pressure = 0;

    // Send the S-Input report
    usb_hid_sinput_send_report(hid_dev, &report);
                                                  
    // Log function timing if it's slow
    uint32_t func_time = k_uptime_get_32() - func_start;
    if (func_time > 5) { // Only warn if function takes over 5ms (was 1ms)
        LOG_WRN("Slow process_controller_data: %dms", func_time);
    }
}

int main(void)
{
    const struct device *hid_dev;
    int ret;

    if (!gpio_is_ready_dt(&led0))
    {
        // LOG_ERR("LED device %s is not ready", led0.port->name);
        return 0;
    }

    ret = gpio_pin_configure_dt(&led0, GPIO_OUTPUT);
    if (ret < 0)
    {
        // LOG_ERR("Failed to configure the LED pin, error: %d", ret);
        return 0;
    }

    // Initialize USB HID S-Input device
    ret = usb_hid_sinput_init();
    if (ret != 0)
    {
        // LOG_ERR("Failed to initialize USB HID");
        return 0;
    }

    // Get the HID device handle
    hid_dev = usb_hid_sinput_get_device();
    if (hid_dev == NULL)
    {
        // LOG_ERR("Failed to get USB HID device");
        return 0;
    }

    // Register haptics callback to forward haptics to controllers
    usb_hid_sinput_register_haptics_callback(haptics_callback);

    // Initialize ESB
    ret = controller_esb_init();
    if (ret != 0)
    {
        // LOG_ERR("Failed to initialize ESB");
        return 0;
    }

    // LOG_INF("Waiting for radio to fully initialize...");
    k_sleep(K_MSEC(500));
    // LOG_INF("Starting ESB ping loop");

    // Main loop - poll controllers and process responses
    uint32_t last_report_time = 0;

    while (true)
    {
        uint32_t now = k_uptime_get_32();
        uint32_t loop_start = now;

        if (now - last_report_time >= 4)
        { // 250Hz (4ms) - low latency USB reporting
            last_report_time = now;
        //     uint32_t process_start = k_uptime_get_32();
            process_controller_data(hid_dev);
        //     uint32_t process_end = k_uptime_get_32();
            
            // Log if processing takes too long
            // uint32_t process_time = process_end - process_start;
            // if (process_time > 5) { // Only warn if processing takes over 5ms (was 2ms)
            //     LOG_WRN("Long processing time: %dms", process_time);
            // }
        }

        // Log if entire loop iteration takes too long
        uint32_t loop_end = k_uptime_get_32();
        uint32_t loop_time = loop_end - loop_start;
        if (loop_time > 10) { // Only warn if loop takes over 10ms (was 3ms)
            LOG_WRN("Long loop time: %dms", loop_time);
        }

        // Small delay to prevent overwhelming the system - increased for better RF processing
        k_sleep(K_USEC(500));
    }
    return 0;
}
```

## src/controller_esb.c
```c
#include "controller_esb.h"
#include <zephyr/drivers/gpio.h>
#include <zephyr/drivers/clock_control.h>
#include <zephyr/drivers/clock_control/nrf_clock_control.h>
#include <zephyr/logging/log.h>

LOG_MODULE_REGISTER(controller_esb, LOG_LEVEL_INF);


// Define the player ID for the controller
#define PLAYER_ID 1

// ESB data structures
static struct esb_payload rx_payload;

// SEPARATE CONTROLLER STATES - prevents data corruption between controllers
static simple_controller_state_t left_controller_state = {0};   // Index 1 (flags & 0x80 = true)
static simple_controller_state_t right_controller_state = {0};  // Index 0 (flags & 0x80 = false)

// LED for debug feedback
static const struct gpio_dt_spec led0 = GPIO_DT_SPEC_GET(DT_ALIAS(led0), gpios);

// Timing tracking for packet logging
static uint32_t last_packet_time = 0;

// ACK payload timing control variables
static uint8_t sequence_counter = 0;
static uint32_t last_tx_time[2] = {0, 0};  // Separate timing for each controller: [0]=right, [1]=left
static uint32_t last_any_rx_time = 0;      // Track most recent packet from ANY controller for collision detection
static const uint16_t BASE_INTERVAL_MS = 4;  // 4ms intervals for low latency (250Hz per controller)
static bool right_phase_toggle = false;     // Toggles RIGHT controller between 2ms and 6ms to maintain 2ms offset from LEFT

// Haptics state
static uint8_t left_rumble_amplitude = 0;
static uint8_t right_rumble_amplitude = 0;

// ESB event handler for ACK-based reception
static void simple_esb_event_handler(struct esb_evt const *event)
{
    // Always log events to debug communication
    // LOG_INF("DONGLE ESB EVENT: %d", event->evt_id);

    switch (event->evt_id)
    {
    case ESB_EVENT_RX_RECEIVED:
        // LOG_INF("RX RECEIVED - got controller data");
        
        uint32_t rx_start = k_uptime_get_32();
        static uint32_t last_rx_process_time = 0;
        
        // Get the received data
        if (esb_read_rx_payload(&rx_payload) == 0)
        {
            // Filter out spurious packets - we only want controller data
            if (rx_payload.length == sizeof(controller_data_t))
            {
                // LOG_INF("Valid controller data - length: %d, pipe: %d", rx_payload.length, rx_payload.pipe);
                // Parse the controller data
                controller_data_t *data = (controller_data_t *)rx_payload.data;

                // Calculate timing and determine controller half
                uint32_t current_time = k_uptime_get_32();
                uint32_t time_diff = current_time - last_packet_time;
                bool is_left = (data->flags & 0x80) != 0;
                uint8_t controller_id = is_left ? 1 : 0;

                // Calculate gap since ANY controller packet for collision detection (BEFORE updating timing)
                uint32_t gap_since_any = (last_any_rx_time == 0) ? 0 : (current_time - last_any_rx_time);

                // Log only problematic timing patterns to reduce logging overhead
                if (last_packet_time != 0 && time_diff < 2)
                {
                    LOG_WRN("COLLISION: %s controller - %dms gap (too close!)",
                            is_left ? "LEFT" : "RIGHT", time_diff);
                    
                    // Also log per-controller timing for collisions
                    uint32_t controller_gap = (last_tx_time[controller_id] == 0) ? 0 : 
                                             (current_time - last_tx_time[controller_id]);
                    LOG_WRN("    Controller gap: %dms since last from THIS controller", controller_gap);
                }

                // Update timing variables AFTER calculating gaps
                last_packet_time = current_time;
                last_any_rx_time = current_time;

                // IMMEDIATE CONTROLLER ROUTING - store data in correct controller array immediately
                // This prevents data corruption when both controllers transmit rapidly
                simple_controller_state_t *target_controller = is_left ? &left_controller_state : &right_controller_state;
                
                target_controller->flags = data->flags;
                target_controller->trigger = data->trigger;
                target_controller->stickX = data->stickX;
                target_controller->stickY = data->stickY;
                target_controller->padX = data->padX;
                target_controller->padY = data->padY;
                target_controller->buttons = data->buttons;
                target_controller->accelX = data->accelX;
                target_controller->accelY = data->accelY;
                target_controller->accelZ = data->accelZ;
                target_controller->gyroX = data->gyroX;
                target_controller->gyroY = data->gyroY;
                target_controller->gyroZ = data->gyroZ;
                target_controller->data_received = true;
                target_controller->last_ping_time = current_time;

                // Track severe delays that indicate controller-side issues
                if (time_diff > 50) {
                    LOG_ERR("SEVERE DELAY: %dms gap from %s controller - likely controller freeze", 
                            time_diff, is_left ? "LEFT" : "RIGHT");
                }

                // Create ACK payload with timing control + rumble (8-byte design)
                ack_timing_data_t ack_data = {
                    .next_delay_ms = 0,        // Will calculate below
                    .sequence_num = sequence_counter++,
                    .left_rumble = left_rumble_amplitude,   // S-Input haptics (0-255)
                    .right_rumble = right_rumble_amplitude, // S-Input haptics (0-255)
                    .reserved = 0,
                    .dongle_timestamp = (uint16_t)(current_time & 0xFFFF) // Truncated timestamp
                };
                
                // Simple fixed staggering: LEFT=4ms, RIGHT=3ms
                // This creates natural offset without complex logic
                // LEFT: 4ms intervals (0, 4, 8, 12, 16, 20, 24ms...) = 250 Hz
                // RIGHT: 3ms intervals (0, 3, 6, 9, 12, 15, 18ms...) = 333 Hz
                // Pattern: Both sync every 12ms, offset in between
                
                uint32_t delay_ms = is_left ? 4 : 3;
                
                // Set the delay
                ack_data.next_delay_ms = delay_ms;
                
                // Log fixed stagger pattern once
                static bool logged_stagger = false;
                if (!logged_stagger) {
                    LOG_INF("FIXED STAGGER: LEFT=4ms (250Hz), RIGHT=3ms (333Hz)");
                    logged_stagger = true;
                }
                
                // Update last transmission time tracking (per-controller)
                last_tx_time[controller_id] = current_time;
                
                // NOTE: last_any_rx_time already updated above after gap calculation
                
                // Queue ACK payload using Nordic's approach - this goes into TX FIFO
                // and will be attached to the ACK for the NEXT packet received on this pipe
                struct esb_payload ack_tx_payload = {0};
                ack_tx_payload.pipe = rx_payload.pipe;        // CRUCIAL - same pipe as RX
                ack_tx_payload.length = sizeof(ack_timing_data_t); // 8 bytes
                memcpy(ack_tx_payload.data, &ack_data, ack_tx_payload.length);
                
                // Queue it - this attaches to the next ACK on this pipe
                int result = esb_write_payload(&ack_tx_payload);
                if (result != 0) {
                    LOG_WRN("Failed to queue ACK payload: %d", result);
                }

                gpio_pin_set_dt(&led0, 1);
            }
            else
            {
                // LOG_DBG("Ignoring packet with wrong length: %d (expected %d)",
                //         rx_payload.length, sizeof(controller_data_t));
            }
        }
        else
        {
            LOG_WRN("Failed to read RX payload");
        }
        
        // Monitor RX processing time
        uint32_t rx_process_time = k_uptime_get_32() - rx_start;
        if (rx_process_time > 2) { // Warn if RX processing takes over 2ms
            LOG_WRN("Slow RX processing: %dms", rx_process_time);
        }
        
        // Track time between RX processing - only warn on major delays
        if (last_rx_process_time != 0) {
            uint32_t rx_interval = rx_start - last_rx_process_time;
            if (rx_interval > 20) { // Only warn if > 20ms (was 8ms)
                LOG_WRN("Long RX interval: %dms", rx_interval);
            }
        }
        last_rx_process_time = rx_start;
        
        break;

    case ESB_EVENT_TX_SUCCESS:
        // ACK payloads transmitted successfully
        break;

    case ESB_EVENT_TX_FAILED:
        LOG_WRN("Failed to send ACK payload - flushing TX queue");
        // For PRX, this usually means the queued ACK payload couldn't be sent
        // Flush the TX FIFO to clear any stuck payloads
        esb_flush_tx();
        break;

    default:
        LOG_WRN("Unknown ESB event: %d", event->evt_id);
        break;
    }
}

// Clock initialization (based on Nordic reference)
int clocks_start(void)
{
    int err;
    int res;
    struct onoff_manager *clk_mgr;
    struct onoff_client clk_cli;

    clk_mgr = z_nrf_clock_control_get_onoff(CLOCK_CONTROL_NRF_SUBSYS_HF);
    if (!clk_mgr)
    {
        LOG_ERR("Unable to get the Clock manager");
        return -ENXIO;
    }

    sys_notify_init_spinwait(&clk_cli.notify);

    err = onoff_request(clk_mgr, &clk_cli);
    if (err < 0)
    {
        LOG_ERR("Clock request failed: %d", err);
        return err;
    }

    do
    {
        err = sys_notify_fetch_result(&clk_cli.notify, &res);
        if (!err && res)
        {
            LOG_ERR("Clock could not be started: %d", res);
            return res;
        }
    } while (err);

    return 0;
}

// Initialize ESB for ACK-based controller communication
int controller_esb_init(void)
{
    int err;

    // Start clocks first (like Nordic reference)
    err = clocks_start();
    if (err)
    {
        LOG_ERR("Clock start failed: %d", err);
        return err;
    }

    // Initialize LED
    if (!gpio_is_ready_dt(&led0))
    {
        return -ENODEV;
    }
    gpio_pin_configure_dt(&led0, GPIO_OUTPUT_INACTIVE);

    // ESB configuration - PRX mode to receive controller data and send ACKs
    // Based on Nordic reference sample
    struct esb_config config = ESB_DEFAULT_CONFIG;
    config.protocol = ESB_PROTOCOL_ESB_DPL;
    config.mode = ESB_MODE_PRX; // Receiver mode to listen and send ACKs
    config.retransmit_delay = 1000;
    config.retransmit_count = 5;
    config.event_handler = simple_esb_event_handler;
    config.bitrate = ESB_BITRATE_2MBPS;
    config.selective_auto_ack = true; // Enable ACK for timing coordination
    config.use_fast_ramp_up = false;

    // Initialize ESB
    err = esb_init(&config);
    if (err)
    {
        LOG_ERR("ESB init failed: %d", err);
        return err;
    }

    // Set addresses - using same pattern as Nordic reference but matching controller
    uint8_t base_addr_0[4];
    uint8_t base_addr_1[4];
    uint8_t addr_prefix[8];
    


#if PLAYER_ID == 1
    // Player 1 addresses
    base_addr_0[0] = 0xE7; base_addr_0[1] = 0xE7; base_addr_0[2] = 0xE7; base_addr_0[3] = 0xE7;
    base_addr_1[0] = 0xD4; base_addr_1[1] = 0xD4; base_addr_1[2] = 0xD4; base_addr_1[3] = 0xD4;
    addr_prefix[0] = 0xE7; addr_prefix[1] = 0xD4; addr_prefix[2] = 0xC3; addr_prefix[3] = 0xC4;
    addr_prefix[4] = 0xC5; addr_prefix[5] = 0xC6; addr_prefix[6] = 0xC7; addr_prefix[7] = 0xC8;
#elif PLAYER_ID == 2
    // Player 2 addresses
    base_addr_0[0] = 0xA1; base_addr_0[1] = 0xA1; base_addr_0[2] = 0xA1; base_addr_0[3] = 0xA1;
    base_addr_1[0] = 0xB2; base_addr_1[1] = 0xB2; base_addr_1[2] = 0xB2; base_addr_1[3] = 0xB2;
    addr_prefix[0] = 0xA1; addr_prefix[1] = 0xB2; addr_prefix[2] = 0xA3; addr_prefix[3] = 0xA4;
    addr_prefix[4] = 0xA5; addr_prefix[5] = 0xA6; addr_prefix[6] = 0xA7; addr_prefix[7] = 0xA8;
#else
    #error "PLAYER_ID must be 1 or 2"
#endif

    err = esb_set_base_address_0(base_addr_0);
    if (err)
    {
        LOG_ERR("ESB set base address 0 failed: %d", err);
        return err;
    }

    err = esb_set_base_address_1(base_addr_1);
    if (err)
    {
        LOG_ERR("ESB set base address 1 failed: %d", err);
        return err;
    }

    err = esb_set_prefixes(addr_prefix, 8);
    if (err)
    {
        LOG_ERR("ESB set prefixes failed: %d", err);
        return err;
    }

    // Set RF channel - using 2450 MHz (channel 50) to avoid WiFi interference
    // This sits between WiFi channels 8 and 9, reducing interference
    err = esb_set_rf_channel(50);
    if (err)
    {
        LOG_ERR("ESB set RF channel failed: %d", err);
        return err;
    }

    // Set radio TX power to maximum
    err = esb_set_tx_power(ESB_TX_POWER_8DBM);
    if (err)
    {
        LOG_ERR("ESB set TX power failed: %d", err);
        return err;
    }

    // Write initial payload (like Nordic PRX reference does)
    struct esb_payload tx_payload = {0};
    tx_payload.length = 8;
    tx_payload.pipe = 0;
    tx_payload.data[0] = 0x10;
    tx_payload.data[1] = 0x11;

    err = esb_write_payload(&tx_payload);
    if (err)
    {
        LOG_ERR("Initial payload write failed: %d", err);
        return err;
    }

    // Start receiving (like Nordic reference)
    err = esb_start_rx();
    if (err)
    {
        LOG_ERR("ESB start RX failed: %d", err);
        return err;
    }

    return 0;
}

// Get current controller state
// Legacy function - returns right controller for backward compatibility
simple_controller_state_t *controller_esb_get_state(void)
{
    return &right_controller_state;
}

// Get left controller state
simple_controller_state_t *controller_esb_get_left_state(void)
{
    return &left_controller_state;
}

// Get right controller state
simple_controller_state_t *controller_esb_get_right_state(void)
{
    return &right_controller_state;
}

// Check if we have new data from either controller
bool controller_esb_has_new_data(void)
{
    // Consider data "new" if we received it within the last 100ms from either controller
    uint32_t now = k_uptime_get_32();
    bool left_has_data = left_controller_state.data_received &&
                        (now - left_controller_state.last_ping_time) < 100;
    bool right_has_data = right_controller_state.data_received &&
                         (now - right_controller_state.last_ping_time) < 100;
    return left_has_data || right_has_data;
}

// Set haptics/rumble values (called from USB HID haptics callback)
void controller_esb_set_haptics(uint8_t left_amplitude, uint8_t right_amplitude)
{
    left_rumble_amplitude = left_amplitude;
    right_rumble_amplitude = right_amplitude;
    
    // Log haptics changes for debugging
    static uint8_t last_left = 0, last_right = 0;
    if (left_amplitude != last_left || right_amplitude != last_right)
    {
        LOG_INF("Haptics set: L=%u, R=%u", left_amplitude, right_amplitude);
        last_left = left_amplitude;
        last_right = right_amplitude;
    }
}
```

## src/controller_esb.h
```c
#ifndef CONTROLLER_ESB_H
#define CONTROLLER_ESB_H

#include <zephyr/kernel.h>
#include <esb.h>

// Controller data structure - must match controller side
typedef struct
{
    uint8_t flags;   // Mode bits, controller ID, mouse buttons, trigger buttons
    uint8_t trigger;  // Analog trigger (L2/R2)
    int8_t stickX;   // Analog stick X
    int8_t stickY;   // Analog stick Y
    int16_t padX;    // Trackpad X (-32767 to 32767)
    int16_t padY;    // Trackpad Y (-32767 to 32767)
    uint8_t buttons; // Digital button states
    int16_t accelX;  // Accelerometer X
    int16_t accelY;  // Accelerometer Y
    int16_t accelZ;  // Accelerometer Z
    int16_t gyroX;   // Gyroscope X
    int16_t gyroY;   // Gyroscope Y
    int16_t gyroZ;   // Gyroscope Z
} __packed controller_data_t;

// ACK payload structure for timing control + rumble (lean design - 8 bytes total)
typedef struct
{
    uint16_t next_delay_ms;      // How long controller should wait before next transmission (0-65535ms)
    uint8_t sequence_num;        // Sequence tracking for debugging/sync
    uint8_t left_rumble;         // Left rumble amplitude (0-255)
    uint8_t right_rumble;        // Right rumble amplitude (0-255)
    uint8_t reserved;            // Reserved for future use
    uint16_t dongle_timestamp;   // Dongle's current time (truncated to 16-bit for space)
} __packed ack_timing_data_t;

// Simple controller state for dongle
typedef struct
{
    uint8_t flags;
    uint8_t trigger;
    int8_t stickX;
    int8_t stickY;
    int16_t padX;
    int16_t padY;
    uint8_t buttons;
    int16_t accelX;
    int16_t accelY;
    int16_t accelZ;
    int16_t gyroX;
    int16_t gyroY;
    int16_t gyroZ;
    bool data_received;
    uint32_t last_ping_time;
} simple_controller_state_t;

// Function declarations
int controller_esb_init(void);
simple_controller_state_t *controller_esb_get_state(void);  // Legacy function - returns right controller
simple_controller_state_t *controller_esb_get_left_state(void);   // Get left controller state
simple_controller_state_t *controller_esb_get_right_state(void);  // Get right controller state
bool controller_esb_has_new_data(void);
void controller_esb_set_haptics(uint8_t left_amplitude, uint8_t right_amplitude);  // Set rumble/haptics

#endif // CONTROLLER_ESB_H
```

## src/usb_hid_sinput.h
```c
#ifndef USB_HID_SINPUT_H
#define USB_HID_SINPUT_H

#include <zephyr/kernel.h>
#include <zephyr/device.h>
#include <zephyr/usb/class/usb_hid.h>

// S-Input Report IDs
#define SINPUT_INPUT_REPORT_ID      0x01
#define SINPUT_COMMAND_REPORT_ID    0x02
#define SINPUT_OUTPUT_REPORT_ID     0x03

// S-Input Gamepad Physical Types (SDL compatibility)
typedef enum {
    SINPUT_TYPE_UNKNOWN = 0,
    SINPUT_TYPE_STANDARD = 1,
    SINPUT_TYPE_XBOX_360 = 2,
    SINPUT_TYPE_XBOX_ONE = 3,
    SINPUT_TYPE_PS3 = 4,
    SINPUT_TYPE_PS4 = 5,
    SINPUT_TYPE_PS5 = 6,
    SINPUT_TYPE_SWITCH_PRO = 7,
    SINPUT_TYPE_JOYCON_LEFT = 8,
    SINPUT_TYPE_JOYCON_RIGHT = 9,
    SINPUT_TYPE_JOYCON_PAIR = 10,
    SINPUT_TYPE_GAMECUBE = 11
} sinput_gamepad_type_t;

// S-Input Face Styles (SDL compatibility)
typedef enum {
    SINPUT_FACE_UNKNOWN = 0,  // Xbox default
    SINPUT_FACE_ABXY = 1,     // Xbox Style: A, B, X, Y
    SINPUT_FACE_AXBY = 2,     // GameCube Style: A, X, B, Y
    SINPUT_FACE_BAYX = 3,     // Nintendo Style: B, A, Y, X
    SINPUT_FACE_SONY = 4      // PS4 Style: X, O, □, △
} sinput_face_style_t;

// S-Input Input Report 0x01 (64 bytes)
#pragma pack(push, 1)
typedef struct {
    uint8_t report_id;          // 0: Report ID (0x01)
    uint8_t plug_status;        // 1: Plug Status (bit flags)
    uint8_t charge_percent;     // 2: Battery charge 0-100
    
    // Buttons (4 bytes total - S-Input official format)
    // Reference: https://docs.handheldlegend.com/s/sinput/doc/buttons-format-esVqGUAjpb
    union {
        struct {
            // Byte 0 (offset 3 in report)
            uint8_t button_south       : 1; // Bit 0: A / Cross
            uint8_t button_east        : 1; // Bit 1: B / Circle
            uint8_t button_west        : 1; // Bit 2: X / Square
            uint8_t button_north       : 1; // Bit 3: Y / Triangle
            uint8_t dpad_up            : 1; // Bit 4: D-pad Up
            uint8_t dpad_down          : 1; // Bit 5: D-pad Down
            uint8_t dpad_left          : 1; // Bit 6: D-pad Left
            uint8_t dpad_right         : 1; // Bit 7: D-pad Right
            
            // Byte 1 (offset 4 in report)
            uint8_t button_stick_left  : 1; // Bit 0: L3
            uint8_t button_stick_right : 1; // Bit 1: R3
            uint8_t button_l_shoulder  : 1; // Bit 2: L1
            uint8_t button_r_shoulder  : 1; // Bit 3: R1
            uint8_t button_l_trigger   : 1; // Bit 4: L2 digital
            uint8_t button_r_trigger   : 1; // Bit 5: R2 digital
            uint8_t button_l_paddle_1  : 1; // Bit 6: L Paddle 1
            uint8_t button_r_paddle_1  : 1; // Bit 7: R Paddle 1
            
            // Byte 2 (offset 5 in report)
            uint8_t button_start       : 1; // Bit 0: Plus/Options
            uint8_t button_select      : 1; // Bit 1: Minus/Share
            uint8_t button_guide       : 1; // Bit 2: Home/PS
            uint8_t button_capture     : 1; // Bit 3: Capture/Misc1
            uint8_t button_l_paddle_2  : 1; // Bit 4: L Paddle 2
            uint8_t button_r_paddle_2  : 1; // Bit 5: R Paddle 2
            uint8_t button_touchpad_1  : 1; // Bit 6: Touchpad Button 1
            uint8_t button_touchpad_2  : 1; // Bit 7: Touchpad Button 2 (Misc 2)
            
            // Byte 3 (offset 6 in report)
            uint8_t button_power       : 1; // Bit 0: Misc 3 (Power)
            uint8_t button_misc_4      : 1; // Bit 1: Misc 4
            uint8_t button_misc_5      : 1; // Bit 2: Misc 5
            uint8_t button_misc_6      : 1; // Bit 3: Misc 6
            uint8_t button_misc_7      : 1; // Bit 4: Unused Misc 7
            uint8_t button_misc_8      : 1; // Bit 5: Unused Misc 8
            uint8_t button_misc_9      : 1; // Bit 6: Unused Misc 9
            uint8_t button_misc_10     : 1; // Bit 7: Unused Misc 10
        };
        struct {
            uint8_t buttons_1;          // 3: Byte 0 of buttons
            uint8_t buttons_2;          // 4: Byte 1 of buttons
            uint8_t buttons_3;          // 5: Byte 2 of buttons
            uint8_t buttons_4;          // 6: Byte 3 of buttons
        };
    };
    
    // Analog inputs (int16, centered at 0)
    int16_t left_x;             // 7-8: Left stick X
    int16_t left_y;             // 9-10: Left stick Y
    int16_t right_x;            // 11-12: Right stick X
    int16_t right_y;            // 13-14: Right stick Y
    int16_t trigger_l;          // 15-16: Left trigger analog (-32768 to 32767, centered at 0)
    int16_t trigger_r;          // 17-18: Right trigger analog (-32768 to 32767, centered at 0)
    
    // IMU data
    uint32_t imu_timestamp_us;  // 19-22: IMU timestamp in microseconds
    int16_t accel_x;            // 23-24: Accelerometer X (Gs)
    int16_t accel_y;            // 25-26: Accelerometer Y
    int16_t accel_z;            // 27-28: Accelerometer Z
    int16_t gyro_x;             // 29-30: Gyroscope X (DPS)
    int16_t gyro_y;             // 31-32: Gyroscope Y
    int16_t gyro_z;             // 33-34: Gyroscope Z
    
    // Touchpad data (X, Y, pressure - single touchpad, app splits in half)
    int16_t touchpad_1_x;       // 35-36: Touchpad 1 X (right controller)
    int16_t touchpad_1_y;       // 37-38: Touchpad 1 Y (right controller)
    int16_t touchpad_1_pressure;// 39-40: Touchpad 1 pressure
    int16_t touchpad_2_x;       // 41-42: Touchpad 2 X (left controller)
    int16_t touchpad_2_y;       // 43-44: Touchpad 2 Y (left controller)
    int16_t touchpad_2_pressure;// 45-46: Touchpad 2 pressure
    
    uint8_t reserved_bulk[17];  // 47-63: Reserved for command response data
} sinput_input_report_t;
#pragma pack(pop)

// S-Input Haptics Type 1 - Precise Stereo Haptics (frequency/amplitude pairs)
#pragma pack(push, 1)
typedef struct {
    uint8_t command_id;         // 0x01
    uint8_t type;               // 0x01
    
    struct {
        uint16_t frequency_1;   // Target: 40-2000 Hz
        uint16_t amplitude_1;
        uint16_t frequency_2;
        uint16_t amplitude_2;
    } left;
    
    struct {
        uint16_t frequency_1;
        uint16_t amplitude_1;
        uint16_t frequency_2;
        uint16_t amplitude_2;
    } right;
} sinput_haptic_type1_t;
#pragma pack(pop)

// S-Input Haptics Type 2 - ERM Stereo Haptics (simple amplitude + brake)
#pragma pack(push, 1)
typedef struct {
    uint8_t command_id;         // 0x01
    uint8_t type;               // 0x02
    
    struct {
        uint8_t amplitude;
        bool brake;
    } left;
    
    struct {
        uint8_t amplitude;
        bool brake;
    } right;
} sinput_haptic_type2_t;
#pragma pack(pop)

// Initialize S-Input USB HID device
int usb_hid_sinput_init(void);

// Get the HID device handle
const struct device* usb_hid_sinput_get_device(void);

// Send S-Input gamepad report
int usb_hid_sinput_send_report(const struct device *hid_dev, const sinput_input_report_t *report);

// Register haptics callback (called when host sends haptics commands)
void usb_hid_sinput_register_haptics_callback(void (*callback)(uint8_t left_amp, uint8_t right_amp));

#endif // USB_HID_SINPUT_H
```
